## daemon-buildroot/Config.in
```kconfig
source "$BR2_EXTERNAL_DAEMON_PATH/package/test-daemon/Config.in"
source "$BR2_EXTERNAL_DAEMON_PATH/package/zig/Config.in.host"
```

## daemon-buildroot/package/test-daemon/Config.in
```kconfig
config BR2_PACKAGE_TEST_DAEMON
        bool "test daemon"
        select BR2_PACKAGE_HOST_ZIG
```

## daemon-buildroot/package/zig/Config.in.host
```kconfig
config BR2_PACKAGE_HOST_ZIG
        bool "host zig"
        help
          zig compiler for the host

          https://ziglang.org/
```
